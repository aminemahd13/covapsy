/*
 * sh1106.c
 *
 * SH1106 128x64 OLED driver on I2C1 (PB7 SDA / PA15 SCL).
 * SH1106 dialect: DC-DC pump enable is 0xAD/0x8B, no horizontal-addressing
 * mode (RAM writes set page/column then stream data).
 * 5x8 font from Adafruit glcdfont, printable ASCII 0x20..0x7E.
 */
#include "sh1106.h"
#include "i2c.h"
#include "usart.h"
#include "stm32g4xx_hal.h"

#include <stdio.h>
#include <string.h>

#define SH1106_ADDR    0x3C

static uint8_t fb[SH1106_FB_BYTES];
static uint8_t cur_col;
static uint8_t cur_row;

/* 5x8 font (Adafruit glcdfont, ASCII 0x20..0x7E). */
static const uint8_t font5x8[95][5] = {
    {0x00,0x00,0x00,0x00,0x00},{0x00,0x00,0x5F,0x00,0x00},{0x00,0x07,0x00,0x07,0x00},
    {0x14,0x7F,0x14,0x7F,0x14},{0x24,0x2A,0x7F,0x2A,0x12},{0x23,0x13,0x08,0x64,0x62},
    {0x36,0x49,0x55,0x22,0x50},{0x00,0x05,0x03,0x00,0x00},{0x00,0x1C,0x22,0x41,0x00},
    {0x00,0x41,0x22,0x1C,0x00},{0x14,0x08,0x3E,0x08,0x14},{0x08,0x08,0x3E,0x08,0x08},
    {0x00,0x50,0x30,0x00,0x00},{0x08,0x08,0x08,0x08,0x08},{0x00,0x60,0x60,0x00,0x00},
    {0x20,0x10,0x08,0x04,0x02},
    /* 0x30 '0' */
    {0x3E,0x51,0x49,0x45,0x3E},{0x00,0x42,0x7F,0x40,0x00},{0x42,0x61,0x51,0x49,0x46},
    {0x21,0x41,0x45,0x4B,0x31},{0x18,0x14,0x12,0x7F,0x10},{0x27,0x45,0x45,0x45,0x39},
    {0x3C,0x4A,0x49,0x49,0x30},{0x01,0x71,0x09,0x05,0x03},{0x36,0x49,0x49,0x49,0x36},
    {0x06,0x49,0x49,0x29,0x1E},
    /* 0x3A ':' */
    {0x00,0x36,0x36,0x00,0x00},{0x00,0x56,0x36,0x00,0x00},{0x00,0x08,0x14,0x22,0x41},
    {0x14,0x14,0x14,0x14,0x14},{0x41,0x22,0x14,0x08,0x00},{0x02,0x01,0x51,0x09,0x06},
    {0x32,0x49,0x79,0x41,0x3E},
    /* 0x41 'A' */
    {0x7E,0x11,0x11,0x11,0x7E},{0x7F,0x49,0x49,0x49,0x36},{0x3E,0x41,0x41,0x41,0x22},
    {0x7F,0x41,0x41,0x22,0x1C},{0x7F,0x49,0x49,0x49,0x41},{0x7F,0x09,0x09,0x01,0x01},
    {0x3E,0x41,0x41,0x51,0x32},{0x7F,0x08,0x08,0x08,0x7F},{0x00,0x41,0x7F,0x41,0x00},
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    {0x03,0x04,0x78,0x04,0x03},{0x61,0x51,0x49,0x45,0x43},
    /* 0x5B '[' */
    {0x00,0x00,0x7F,0x41,0x41},{0x02,0x04,0x08,0x10,0x20},{0x41,0x41,0x7F,0x00,0x00},
    {0x04,0x02,0x01,0x02,0x04},{0x40,0x40,0x40,0x40,0x40},{0x00,0x01,0x02,0x04,0x00},
    /* 0x61 'a' */
    {0x20,0x54,0x54,0x54,0x78},{0x7F,0x48,0x44,0x44,0x38},{0x38,0x44,0x44,0x44,0x20},
    {0x38,0x44,0x44,0x48,0x7F},{0x38,0x54,0x54,0x54,0x18},{0x08,0x7E,0x09,0x01,0x02},
    {0x08,0x14,0x54,0x54,0x3C},{0x7F,0x08,0x04,0x04,0x78},{0x00,0x44,0x7D,0x40,0x00},
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    {0x0C,0x50,0x50,0x50,0x3C},{0x44,0x64,0x54,0x4C,0x44},
    /* 0x7B '{' */
    {0x00,0x08,0x36,0x41,0x00},{0x00,0x00,0x7F,0x00,0x00},{0x00,0x41,0x36,0x08,0x00},
    {0x08,0x04,0x08,0x10,0x08},
};

/* Send each command in its own I2C transaction (control byte 0x00 + 1 cmd), up to 3 retries each. */
static bool sh1106_cmds(const uint8_t *cmds, uint16_t n)
{
    for (uint16_t i = 0; i < n; i++) {
        uint8_t pkt[2] = {0x00, cmds[i]};
        bool ok = false;
        for (int retry = 0; retry < 3 && !ok; retry++) {
            ok = i2c1_write(SH1106_ADDR, pkt, 2);
            if (!ok) {
                for (volatile uint32_t d = 0; d < 5000; d++) { }
            }
        }
        if (!ok) return false;
        for (volatile uint32_t d = 0; d < 10000; d++) { }
    }
    return true;
}

/* Set page-address + column cursor for `page` (3 command writes, each retried). Must precede any data burst. */
static bool sh1106_page_setup(uint8_t page)
{
    uint8_t setup[3] = {
        (uint8_t)(0xB0 | page),
        (uint8_t)(0x00 | (SH1106_COL_OFF & 0x0F)),
        (uint8_t)(0x10 | ((SH1106_COL_OFF >> 4) & 0x0F)),
    };
    for (int i = 0; i < 3; i++) {
        uint8_t pkt[2] = {0x00, setup[i]};
        bool ok = false;
        for (int retry = 0; retry < 3 && !ok; retry++) {
            ok = i2c1_write(SH1106_ADDR, pkt, 2);
            if (!ok) { for (volatile uint32_t d = 0; d < 5000; d++) { } }
        }
        if (!ok) return false;
        for (volatile uint32_t d = 0; d < 5000; d++) { }
    }
    return true;
}

/* One full page update (polled): cursor setup, then stream 128 pixel bytes. Retried as a unit. */
static bool sh1106_send_page(uint8_t page, const uint8_t *fb_page)
{
    uint8_t data[1 + SH1106_W];
    data[0] = 0x40;
    memcpy(&data[1], fb_page, SH1106_W);

    for (int attempt = 0; attempt < 3; attempt++) {
        if (sh1106_page_setup(page) && i2c1_write(SH1106_ADDR, data, sizeof data))
            return true;
        for (volatile uint32_t d = 0; d < 5000; d++) { }
    }
    return false;
}

bool sh1106_init(void)
{
    /* SH1106 init sequence. 0xAD 0x8B enables the DC-DC charge pump; writes are page-based. */
    static const uint8_t init[] = {
        0xAE,                /* display off */
        0xD5, 0x80,          /* clock divide ratio / osc freq */
        0xA8, 0x3F,          /* multiplex = 64 - 1 */
        0xD3, 0x00,          /* display offset = 0 */
        0x40,                /* start line = 0 */
        0xAD, 0x8B,          /* DC-DC charge pump ON (SH1106 dialect) */
        0xA1,                /* segment remap (horizontal flip) */
        0xC8,                /* COM scan direction remapped (vertical flip) */
        0xDA, 0x12,          /* COM pins hw config */
        0x81, 0xCF,          /* contrast */
        0xD9, 0xF1,          /* pre-charge */
        0xDB, 0x40,          /* VCOMH deselect */
        0xA4,                /* resume display from RAM */
        0xA6,                /* normal (not inverted) */
        0xAF,                /* display on */
    };
    if (!sh1106_cmds(init, sizeof init)) return false;
    sh1106_clear();
    /* Wipe all 8 pages; power-on RAM is random. */
    return sh1106_show_full();
}

void sh1106_clear(void)
{
    memset(fb, 0, sizeof fb);
    cur_col = 0;
    cur_row = 0;
}

void sh1106_set_cursor(uint8_t col, uint8_t row)
{
    cur_col = col;
    cur_row = row;
}

static void put_glyph(char ch)
{
    if (ch < 0x20 || ch > 0x7E) ch = '?';
    if (cur_col >= (SH1106_W / 6) || cur_row >= SH1106_PAGES) return;

    uint16_t x = cur_col * 6;
    uint16_t page = cur_row;
    const uint8_t *glyph = font5x8[ch - 0x20];
    for (uint8_t i = 0; i < 5; i++) {
        fb[page * SH1106_W + x + i] = glyph[i];
    }
    fb[page * SH1106_W + x + 5] = 0x00;
    cur_col++;
}

void sh1106_puts(const char *s)
{
    while (*s) {
        if (*s == '\n') {
            cur_col = 0;
            cur_row++;
        } else {
            put_glyph(*s);
            if (cur_col >= (SH1106_W / 6)) {
                cur_col = 0;
                cur_row++;
            }
        }
        s++;
    }
}

void sh1106_print_row(uint8_t row, const char *s)
{
    memset(&fb[row * SH1106_W], 0, SH1106_W);
    cur_col = 0;
    cur_row = row;
    sh1106_puts(s);
}

static bool sh1106_push_pages(uint8_t first, uint8_t last_excl)
{
    for (uint8_t page = first; page < last_excl; page++) {
        if (!sh1106_send_page(page, &fb[page * SH1106_W])) return false;
    }
    return true;
}

bool sh1106_show(void)      { return sh1106_push_pages(0, 4); }
bool sh1106_show_full(void) { return sh1106_push_pages(0, SH1106_PAGES); }

bool sh1106_show_page(uint8_t page)
{
    if (page >= SH1106_PAGES) return true;
    return sh1106_send_page(page, &fb[page * SH1106_W]);
}

/* Non-blocking DMA refresh state machine.
 * Per page: polled cursor setup (~0.6 ms), then 129-byte data burst via DMA. One page per ~12 ms. */

enum { RF_IDLE = 0, RF_START, RF_WAIT };
static uint8_t  rf_state = RF_IDLE;
static uint8_t  rf_page;
static uint8_t  rf_retry;
static uint32_t rf_t0;
static uint8_t  rf_buf[1 + SH1106_W];   /* held valid for the duration of each DMA */

void sh1106_refresh_begin(void)
{
    if (rf_state != RF_IDLE) return;     /* previous frame still streaming */
    rf_page  = 0;
    rf_retry = 0;
    rf_state = RF_START;
}

bool sh1106_refresh_idle(void) { return rf_state == RF_IDLE; }

void sh1106_refresh_poll(void)
{
    switch (rf_state) {
    case RF_IDLE:
        return;

    case RF_START:
        if (rf_page >= SH1106_PAGES) { rf_state = RF_IDLE; return; }
        sh1106_page_setup(rf_page);                 /* polled cursor (tiny) */
        rf_buf[0] = 0x40;
        memcpy(&rf_buf[1], &fb[rf_page * SH1106_W], SH1106_W);
        if (i2c1_write_dma_start(SH1106_ADDR, rf_buf, sizeof rf_buf)) {
            rf_t0    = HAL_GetTick();
            rf_state = RF_WAIT;
        } else {
            /* Bus busy; fall back to a polled push. */
            sh1106_send_page(rf_page, &fb[rf_page * SH1106_W]);
            rf_page++;
            rf_retry = 0;
        }
        return;

    case RF_WAIT: {
        int r = i2c1_write_dma_poll();
        if (r == 0) {
            if ((HAL_GetTick() - rf_t0) > 50u) {    /* stuck after 50 ms; abort, treat as error */
                i2c1_dma_abort();
                r = -1;
            } else {
                return;                              /* still streaming; don't block */
            }
        }
        if (r == 1) {                                /* page done */
            rf_page++;
            rf_retry = 0;
            rf_state = RF_START;
            return;
        }
        /* r < 0: NACK/timeout. Retry the whole page (setup + data); after 3 fails, polled push and move on. */
        if (++rf_retry >= 3) {
            i2c1_recover();   /* unjam the bus, then render via polled push */
            sh1106_send_page(rf_page, &fb[rf_page * SH1106_W]);
            rf_page++;
            rf_retry = 0;
        }
        rf_state = RF_START;
        return;
    }
    }
}
